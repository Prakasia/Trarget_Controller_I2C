## CMakeLists.txt
```
cmake_minimum_required(VERSION 3.20.0)

# Select our board 
set(BOARD rpi_pico)

# Find/Select cmake package 'Zephyr' 
find_package(Zephyr)

# This is only used by IntelliSense inside VS Code 
set(CMAKE_EXPORT_COMPILE_COMMANDS ON)

# For using west flash with picoprobe
set(OPENOCD "openocd")
set(OPENOCD_DEFAULT_PATH "/usr/local/share/openocd/scripts")

# Define project name
project(master_slave_code)

# Add include directory 
target_include_directories(app PRIVATE src/inc)

# Add source files
FILE(GLOB SRC_FILES "src/*.c")
target_sources(app PRIVATE ${SRC_FILES})
```

## prj.conf
```kconfig
CONFIG_GPIO=y
CONFIG_I2C=y
CONFIG_I2C_TARGET=y
CONFIG_ADC=y

CONFIG_DEBUG=y

CONFIG_NEWLIB_LIBC=y
CONFIG_NEWLIB_LIBC_FLOAT_PRINTF=y
```

## rpi_pico.overlay
```dts
#include <zephyr/dt-bindings/adc/adc.h>

&pinctrl {
	i2c1_default: i2c1_default {
		group1 {
			pinmux = <I2C1_SDA_P2>, <I2C1_SCL_P3>;       
			input-enable;
			input-schmitt-enable;
		};
	};
};
&i2c1 {
	clock-frequency = <I2C_BITRATE_STANDARD>;
	status = "okay";
	pinctrl-0 = <&i2c1_default>;
	pinctrl-names = "default";
};
```

## src/main.c
```c
/**
 * 
 * 
 * **********	SLAVE CODE			***********
 * 
 * 
 *
*/

#include <inttypes.h>
#include <stddef.h>
#include <stdint.h>

#include <zephyr/kernel.h>
#include <zephyr/device.h>
#include <zephyr/devicetree.h>
#include <zephyr/drivers/adc.h>
#include <zephyr/drivers/gpio.h>
#include <zephyr/sys/util.h>
#include <zephyr/drivers/i2c.h>
#include <stdio.h>



#define I2C_TARGET_ADDRESS  0x07                  //ADDRESS OF THE SLAVE 

#define LED0_NODE DT_ALIAS(led0)

#define I2C_NODE    DT_NODELABEL(i2c1) 
#define BUF_LEN 12
#define DELAY_MS  500	
#define STACK_SIZE  500 

const struct device *const dev = DEVICE_DT_GET(I2C_NODE);
int ret;

// dummy data
uint8_t data[BUF_LEN];
uint32_t buff_idx;
bool m_read;

int16_t soilbuf;
int16_t airbuf;
int32_t hum_comp;
int32_t temp_comp;

// read request callback
int master_read(struct i2c_target_config *config, uint8_t *val)
{
    m_read = true;
    *val = data[buff_idx];
    printf("Read value = %d", *val);
    return 0;
};

// read processed callback for incrementing the data index
int master_continue(struct i2c_target_config *config, uint8_t *val)
{
    buff_idx = (buff_idx + 1) % BUF_LEN;
	*val = data[buff_idx];
    printf("Read value = %d", *val);
    return 0;
};

// callbacks
struct i2c_target_callbacks cb = {
    .read_requested = master_read,
    .read_processed = master_continue,
};

// slave configurations
struct i2c_target_config slave_config = {
    .address = I2C_TARGET_ADDRESS,
    .callbacks = &cb,
};


void main(){
    if (!device_is_ready(dev)) { 
        printk("error");
        return;
	}
    else{
        printk("Device ready");
    }

    ret = i2c_target_register(dev, &slave_config);
    if (ret < 0) { 
        printk("error value %d",ret); 
        return;
    }
    else{
        printk("Successfully registered!!");
    }
    soilbuf = 1023;
    airbuf = 700;
    hum_comp = 258976;
    temp_comp = 24657;
    while (1)
    {
        if(!m_read){
            data[0] = (uint8_t)((soilbuf & 0xFF00) >> 8);       //soilbuf MSB
            data[1] = (uint8_t)((soilbuf & 0x00FF));            //soilbuf LSB

            data[2] = (uint8_t)((airbuf & 0xFF00) >> 8);        //airbuf MSB
            data[3] = (uint8_t)((airbuf & 0x00FF));             //airbuf LSB

            data[4] = (uint8_t)((hum_comp >> 24) & 0xFF);       //humidity MSB
            data[5] = (uint8_t)((hum_comp >> 16) & 0xFF);
            data[6] = (uint8_t)((hum_comp >> 8) & 0xFF);
            data[7] = (uint8_t)(hum_comp & 0xFF);               //humidity LSB

            data[8] = (uint8_t)((temp_comp >> 24) & 0xFF);      //temp MSB     
            data[9] = (uint8_t)((temp_comp >> 16) & 0xFF);
            data[10] = (uint8_t)((temp_comp >> 8) & 0xFF);
            data[11] = (uint8_t)(temp_comp & 0xFF);             //temp LSB
        }
    }

    k_sleep(K_MSEC(1000));
    

}
```
